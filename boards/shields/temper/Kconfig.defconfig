## boards/shields/temper/Kconfig.defconfig
```kconfig
if SHIELD_TEMPER_DONGLE

config ZMK_KEYBOARD_NAME
    default "temper"

config ZMK_SPLIT_ROLE_CENTRAL
    default y

config ZMK_SPLIT
    default y

# Set this to the number of peripherals your dongle will have.
# For a unibody, this would be 1. If you have left and right halves, set it to 2, etc.
config ZMK_SPLIT_BLE_CENTRAL_PERIPHERALS
    default 2

# Set this to ZMK_SPLIT_BLE_CENTRAL_PERIPHERALS + your desired number of BT profiles (default is 5)
config BT_MAX_CONN
    default 2

# Set this to the same number as BT_MAX_CONN
config BT_MAX_PAIRED
    default 2

config CONFIG_ZMK_SPLIT_BLE_CENTRAL_BATTERY_LEVEL_FETCHING
    default y

config CONFIG_ZMK_SPLIT_BLE_CENTRAL_BATTERY_LEVEL_PROXY
    default y

endif

if SHIELD_TEMPER_LEFT || SHIELD_TEMPER_RIGHT

config ZMK_SPLIT
    default y

endif
```
